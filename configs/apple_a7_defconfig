## configs/apple_a7_defconfig
```kconfig
CONFIG_ARM=y
CONFIG_ARM64_64K_PAGES=y
# CONFIG_ARM64_CRC32 is not set
CONFIG_MISC=y
CONFIG_ARCH_APPLE=y
CONFIG_DEFAULT_DEVICE_TREE="t8103-j274"
CONFIG_SYS_BOOTM_LEN=0x800000
CONFIG_SYS_LOAD_ADDR=0x0
CONFIG_BOOTCOMMAND="bootflow scan -b"
CONFIG_USE_PREBOOT=y
CONFIG_SYS_CBSIZE=256
CONFIG_SYS_PBSIZE=276
# CONFIG_DISPLAY_CPUINFO is not set
CONFIG_DISPLAY_BOARDINFO_LATE=y
CONFIG_BOARD_LATE_INIT=y
CONFIG_CMD_SELECT_FONT=y
CONFIG_NVME_APPLE=y
CONFIG_NO_NET=y
CONFIG_SYS_64BIT_LBA=y
CONFIG_VIDEO_FONT_16X32=y
CONFIG_SYS_WHITE_ON_BLACK=y
CONFIG_NO_FB_CLEAR=y
CONFIG_USB_DWC2=y
CONFIG_USB_EHCI_GENERIC=y
CONFIG_USB_EHCI_HCD=y
CONFIG_VIDEO_SIMPLE=y
# CONFIG_SMBIOS is not set
```
